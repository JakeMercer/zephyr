## boards/ti/ek_tm4c123gxl/Kconfig.ek_tm4c123gxl
```kconfig
# SPDX-License-Identifier: Apache-2.0

config BOARD_EK_TM4C123GXL
	select SOC_TM4C123GH6PM
```

## boards/ti/ek_tm4c123gxl/board.yml
```yaml
board:
  name: ek_tm4c123gxl
  full_name: TI EK-TM4C123GXL LaunchPad
  vendor: ti
  socs:
  - name: tm4c123gh6pm
```

## boards/ti/ek_tm4c123gxl/ek_tm4c123gxl_defconfig
```kconfig
# SPDX-License-Identifier: Apache-2.0

CONFIG_BUILD_OUTPUT_HEX=y
CONFIG_SYS_CLOCK_HW_CYCLES_PER_SEC=16000000
```

## soc/ti/tm4c/Kconfig
```kconfig
# SPDX-License-Identifier: Apache-2.0

if SOC_FAMILY_TI_TIVA

rsource "*/Kconfig"

endif # SOC_FAMILY_TI_TIVA
```

## soc/ti/tm4c/Kconfig.defconfig
```kconfig
# SPDX-License-Identifier: Apache-2.0

if SOC_FAMILY_TI_TIVA

rsource "*/Kconfig.defconfig"

endif # SOC_FAMILY_TI_TIVA
```

## soc/ti/tm4c/Kconfig.soc
```kconfig
# SPDX-License-Identifier: Apache-2.0

config SOC_FAMILY_TI_TIVA
	bool

config SOC_FAMILY
	default "ti_tiva" if SOC_FAMILY_TI_TIVA

rsource "*/Kconfig.soc"
```

## soc/ti/tm4c/tm4c123x/Kconfig
```kconfig
# SPDX-License-Identifier: Apache-2.0

if SOC_SERIES_TM4C123X

config SOC_SERIES_TM4C123X
	select ARM
	select CPU_CORTEX_M4
	select CPU_CORTEX_M_HAS_DWT
	select CPU_HAS_FPU
	select HAL_TI_TIVAWARE

endif # SOC_SERIES_TM4C123X
```

## soc/ti/tm4c/tm4c123x/Kconfig.defconfig
```kconfig
# SPDX-License-Identifier: Apache-2.0

if SOC_TM4C123GH6PM

config NUM_IRQS
	default 139

config HAL_TI_TIVAWARE_PART
	default "PART_TM4C123GH6PM"

endif # SOC_TM4C123GH6PM
```

## soc/ti/tm4c/tm4c123x/Kconfig.soc
```kconfig
# SPDX-License-Identifier: Apache-2.0

config SOC_SERIES_TM4C123X
	bool
	select SOC_FAMILY_TI_TIVA
	help
	  TI Tiva TM4C123 series

config SOC_SERIES
	default "tm4c123x" if SOC_SERIES_TM4C123X

config SOC_TM4C123GH6PM
	bool
	select SOC_SERIES_TM4C123X
	help
	  TI TM4C123GH6PM

config SOC
	default "tm4c123gh6pm" if SOC_TM4C123GH6PM
```

## soc/ti/tm4c/tm4c129x/Kconfig
```kconfig
# SPDX-License-Identifier: Apache-2.0

if SOC_SERIES_TM4C129X

config SOC_SERIES_TM4C129X
	select ARM
	select CPU_CORTEX_M4
	select CPU_CORTEX_M_HAS_DWT
	select CPU_HAS_FPU
	select HAL_TI_TIVAWARE

endif # SOC_SERIES_TM4C129X
```

## soc/ti/tm4c/tm4c129x/Kconfig.defconfig
```kconfig
# SPDX-License-Identifier: Apache-2.0

if SOC_TM4C1294NCPDT

config NUM_IRQS
	default 113

config HAL_TI_TIVAWARE_PART
	default "PART_TM4C1294NCPDT"

endif # SOC_TM4C1294NCPDT
```

## soc/ti/tm4c/tm4c129x/Kconfig.soc
```kconfig
# SPDX-License-Identifier: Apache-2.0

config SOC_SERIES_TM4C129X
	bool
	select SOC_FAMILY_TI_TIVA
	help
	  TI Tiva TM4C129 series

config SOC_SERIES
	default "tm4c129x" if SOC_SERIES_TM4C129X

config SOC_TM4C1294NCPDT
	bool
	select SOC_SERIES_TM4C129X
	help
	  TI TM4C1294NCPDT

config SOC
	default "tm4c1294ncpdt" if SOC_TM4C1294NCPDT
```
